__CONFIG H'3F31'
LIST P=16F877A
#INCLUDE<P16F877A.INC>

SAYI1 EQU 0X20
SAYI2 EQU 0X21
SAYAC EQU 0X22
SANIYE1 EQU 0X23
SANIYE2 EQU 0X24
TIMER_SAYAC EQU 0X25
ORG 0X00
GOTO BASLA
ORG 0X04
GOTO KESME

TABLO

	ADDWF PCL,F
	RETLW H'3F'
	RETLW H'06'
	RETLW H'5B'
	RETLW H'4F'
	RETLW H'66'
	RETLW H'6D'
	RETLW H'7D'
	RETLW H'07'
	RETLW H'7F'
	RETLW H'6F'
	


IO_AYARLAR

	BANKSEL ADCON1
	MOVLW 0X06
	MOVWF ADCON1
	BANKSEL TRISB
	CLRF TRISB
	BANKSEL TRISA
	CLRF TRISA
	BANKSEL PORTA
	CLRF PORTA
	BANKSEL PORTA
	CLRF PORTA
	CLRF SAYI1
	CLRF SAYI2
	RETURN

TIMER_AYARLAR
	
	BSF INTCON,GIE
	BSF INTCON,TMR0IE
	BCF INTCON,TMR0IF
	BANKSEL OPTION_REG
	MOVLW B'00000100'			;PRESCALER 1:32
	MOVWF OPTION_REG
	BANKSEL TMR0
	MOVLW D'6'
	MOVWF TMR0
	MOVLW H'3F'
	MOVWF SANIYE1
	MOVLW H'3F'
	MOVWF SANIYE2
	MOVLW D'125'
	MOVWF TIMER_SAYAC
	RETURN

BASLA
	
	CALL IO_AYARLAR
	CALL TIMER_AYARLAR	

CALIS

	MOVLW H'FF'
	MOVWF PORTA
	BCF PORTA,0
	BSF PORTA,1
	MOVF SANIYE1,W
	MOVWF PORTB
	CALL GECIKME

	BSF PORTA,0
	BCF PORTA,1
	MOVLW D'06'
	SUBWF SAYI2,W
	BTFSC STATUS,Z
	CLRF SAYI2
	MOVF SANIYE2,W
	MOVWF PORTB
	CALL GECIKME
	GOTO CALIS

GECIKME

	MOVLW 0XFF
	MOVWF SAYAC
GECIKME1
	DECFSZ SAYAC,F
	GOTO GECIKME1
	RETURN

KESME

	BCF INTCON,TMR0IF
	MOVLW D'6'
	MOVWF TMR0
	DECFSZ TIMER_SAYAC,F
	GOTO SON
	MOVLW D'125'
	MOVWF TIMER_SAYAC
	INCF SAYI1,F
	MOVLW D'10'
	SUBWF SAYI1,W
	BTFSS STATUS,Z
	GOTO YAZ1
	GOTO YAZ2

YAZ1

	MOVF SAYI1,W
	CALL TABLO
	MOVWF SANIYE1
	GOTO SON

YAZ2

	CLRF SAYI1
	MOVLW B'00111111'
	MOVWF SANIYE1
	BCF STATUS,Z
	INCF SAYI2,F
	MOVLW D'6'
	SUBWF SAYI2,W
	BTFSC STATUS,Z
	GOTO BASLA
	MOVF SAYI2,W
	CALL TABLO
	MOVWF SANIYE2
	
SON
	RETFIE




END